## sdkconfig.defaults
```kconfig
# ESP WiFi Repeater - sdkconfig defaults (universal)
# Chip-specific overrides in sdkconfig.defaults.esp32c6 / sdkconfig.defaults.esp32s3

# ── WiFi driver buffers (throughput critical) ──
# Static RX: hardware buffers, ~1.6KB each. Must be >= RX_BA_WIN.
CONFIG_ESP_WIFI_STATIC_RX_BUFFER_NUM=16
# Dynamic RX: copies of frames handed to TCP/IP. Higher = less drops under load.
CONFIG_ESP_WIFI_DYNAMIC_RX_BUFFER_NUM=64
# Dynamic TX: allocated per-frame. Both interfaces forward simultaneously.
CONFIG_ESP_WIFI_DYNAMIC_TX_BUFFER_NUM=64

# ── AMPDU (aggregation — critical for throughput) ──
CONFIG_ESP_WIFI_AMPDU_TX_ENABLED=y
CONFIG_ESP_WIFI_TX_BA_WIN=12
CONFIG_ESP_WIFI_AMPDU_RX_ENABLED=y
CONFIG_ESP_WIFI_RX_BA_WIN=12

# ── WiFi IRAM (hot path in fast memory) ──
CONFIG_ESP_WIFI_IRAM_OPT=y
CONFIG_ESP_WIFI_EXTRA_IRAM_OPT=y
CONFIG_ESP_WIFI_RX_IRAM_OPT=y
CONFIG_ESP_WIFI_SLP_IRAM_OPT=y

# ── WiFi general ──
CONFIG_ESP_WIFI_SOFTAP_SUPPORT=y
CONFIG_ESP_WIFI_STA_DISCONNECTED_PM_ENABLE=n
CONFIG_ESP_WIFI_ENABLE_WPA3_SAE=y

# ── Power save: DISABLE during operation for lowest latency ──
# (we manage PM in code: disable during bridging)

# ── lwIP tuning ──
CONFIG_ESP_NETIF_TCPIP_LWIP=y
CONFIG_LWIP_IP_FORWARD=y
CONFIG_LWIP_IPV4_NAPT=n
CONFIG_LWIP_TCP_SND_BUF_DEFAULT=65534
CONFIG_LWIP_TCP_WND_DEFAULT=65534
CONFIG_LWIP_TCP_RECVMBOX_SIZE=64
CONFIG_LWIP_UDP_RECVMBOX_SIZE=64
CONFIG_LWIP_TCPIP_RECVMBOX_SIZE=64

# ── lwIP IRAM ──
CONFIG_LWIP_IRAM_OPTIMIZATION=y

# ── FreeRTOS ──
CONFIG_FREERTOS_HZ=1000

# ── System ──
CONFIG_ESP_TASK_WDT_TIMEOUT_S=10

# ── Log level ──
CONFIG_LOG_DEFAULT_LEVEL_INFO=y
```

## sdkconfig.defaults.esp32
```kconfig
# ESP32 (classic): WiFi 4 (11b/g/n), dual-core Xtensa LX6, max 240 MHz
CONFIG_ESP_DEFAULT_CPU_FREQ_MHZ=240
```

## sdkconfig.defaults.esp32c3
```kconfig
# ESP32-C3 specific: WiFi 4 (11n), single-core RISC-V, max 160 MHz
CONFIG_ESP_DEFAULT_CPU_FREQ_MHZ=160
```

## sdkconfig.defaults.esp32c6
```kconfig
# ESP32-C6 specific: WiFi 6 (HE), single-core RISC-V, max 160 MHz
CONFIG_ESP_DEFAULT_CPU_FREQ_MHZ=160
```

## sdkconfig.defaults.esp32s3
```kconfig
# ESP32-S3 specific: WiFi 4 (11n), dual-core Xtensa LX7, max 240 MHz
CONFIG_ESP_DEFAULT_CPU_FREQ_MHZ=240
```
